## configs/televic_confidea_g4_wdu_defconfig
```kconfig
BR2_arm=y
BR2_cortex_a7=y
BR2_ARM_FPU_NEON_VFPV4=y
BR2_TOOLCHAIN_EXTERNAL=y
BR2_PACKAGE_HOST_GDB=y
BR2_PACKAGE_HOST_GDB_TUI=y
BR2_TARGET_GENERIC_ISSUE="confidea g4 wdu"
BR2_ROOTFS_DEVICE_CREATION_DYNAMIC_EUDEV=y
BR2_ROOTFS_DEVICE_TABLE="system/device_table.txt board/televic/confidea_g4_wdu/device_table.txt"
BR2_TARGET_GENERIC_ROOT_PASSWD="root"
BR2_TARGET_GENERIC_GETTY_PORT="ttymxc1"
BR2_ROOTFS_OVERLAY="board/televic/confidea_g4_wdu/rootfs_overlay"
BR2_ROOTFS_POST_BUILD_SCRIPT="board/televic/confidea_g4_wdu/pre-image.sh"
BR2_ROOTFS_POST_IMAGE_SCRIPT="board/televic/confidea_g4_wdu/post-image.sh"
BR2_LINUX_KERNEL=y
BR2_LINUX_KERNEL_CUSTOM_GIT=y
BR2_LINUX_KERNEL_CUSTOM_REPO_URL="https://github.com/armessia/linux.git"
BR2_LINUX_KERNEL_CUSTOM_REPO_VERSION="237f32b11991ddbb804286141c5acab5fdb7d624"
BR2_LINUX_KERNEL_DEFCONFIG="imx7d_televic"
BR2_LINUX_KERNEL_LZO=y
BR2_LINUX_KERNEL_DTS_SUPPORT=y
BR2_LINUX_KERNEL_INTREE_DTS_NAME="imx7d-televic-confidea-g4-wdu-v0.04-display imx7d-televic-confidea-g4-wdu-v0.06-display"
BR2_LINUX_KERNEL_INSTALL_TARGET=y
BR2_LINUX_KERNEL_NEEDS_HOST_OPENSSL=y
BR2_PACKAGE_BUSYBOX_CONFIG="board/televic/confidea_g4_wdu/busybox.config"
BR2_PACKAGE_JQ=y
BR2_PACKAGE_E2FSPROGS=y
BR2_PACKAGE_LINUX_FIRMWARE=y
BR2_PACKAGE_LINUX_FIRMWARE_IMX_SDMA=y
BR2_PACKAGE_MEMTESTER=y
BR2_PACKAGE_RNG_TOOLS=y
BR2_PACKAGE_UBOOT_TOOLS=y
BR2_PACKAGE_UBOOT_TOOLS_MKIMAGE=y
BR2_PACKAGE_LIBGPIOD=y
BR2_PACKAGE_LIBGPIOD_TOOLS=y
BR2_PACKAGE_DROPBEAR=y
BR2_PACKAGE_DROPBEAR_DISABLE_REVERSEDNS=y
BR2_TARGET_ROOTFS_TAR_XZ=y
BR2_GLOBAL_PATCH_DIR="board/televic/confidea_g4_wdu/patches/"
```
